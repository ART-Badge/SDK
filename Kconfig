## Kconfig
```kconfig
mainmenu "RT-Thread Configuration"

config BSP_DIR
    string
    default "."

config RTT_DIR
    string
    default "./rt-thread"

config PKGS_DIR
    string
    option env="PKGS_ROOT"
    default "packages"

config JSFW_DIR
    string
    default "packages/persimwear-js-fwk"

source "$RTT_DIR/Kconfig"
source "$PKGS_DIR/Kconfig"
source "$JSFW_DIR/Kconfig"
source "board/Kconfig"
```

## board/Kconfig
```kconfig
menu "Hardware Drivers Config"

config SOC_RTL_8762D
    bool
    select RT_USING_COMPONENTS_INIT
    select ARCH_ARM_CORTEX_M4
    default y

menu "Onboard Peripheral Drivers"
config BSP_USING_MPU6050
    bool "Enable MPU6050"
    default n
    select BSP_USING_I2C
    select BSP_USING_I2C1
    select PKG_USING_SENSORS_DRIVERS
    select PKG_USING_MPU6XXX

config BSP_USING_LCD
    bool "Enable LCD"
    default n

config BSP_USING_TOUCHPAD
    bool "Enable touchpad"
    default n
    select PKG_USING_FLEXIBLE_BUTTON

config BSP_USING_SIMULATOR_TOUCH
    bool "Enable simulator touch"
    default n

menu "On-chip Peripheral Drivers"
    menuconfig BSP_USING_UART
        bool "Enable UART"
        default y
        select RT_USING_SERIAL
        if BSP_USING_UART
            config BSP_USING_UART0
                bool "Enable UART0"
                default y
            config BSP_UART0_RX_USING_DMA
                bool "Enable UART0 RX DMA"
                depends on BSP_USING_UART0
                select RT_SERIAL_USING_DMA
                default n
        endif

    menuconfig BSP_USING_PSRAM
        bool "Enable psram"
        default n

    menuconfig BSP_USING_BLE
        bool "Enable BLE"
        default n
        if BSP_USING_BLE
                config BSP_USING_REALTEK_BLE
                    bool "Enable REALTEK BLE"
                    default y
                config BSP_USING_BSAL
                    select PKG_USING_BSAL
                    bool "Enable BSAL BLE"
                    default n
        endif

    menuconfig BSP_USING_PIN
        select RT_USING_PIN
        bool "Enable PIN device"
        default n

    menuconfig BSP_USING_I2C
        select RT_USING_I2C
        bool "Enable I2C Bus"
        default n
        if BSP_USING_I2C
                config BSP_USING_I2C1
                    bool "Enable I2C1"
                    default y
        endif

    menuconfig BSP_USING_FLASH
        bool "Enable Flash"
        default n

    menuconfig BSP_USING_UDBD
        bool "Enable udbd"
        default n
        if BSP_USING_UDBD
                config BSP_USING_UDBD_NAME
                prompt "config your udb device name"
                string "the device name for udb"
                    default "uart0"
        endif

    menuconfig BSP_USING_PWM
        bool "Enable pwm"
        default n
        select RT_USING_PWM
        if BSP_USING_PWM
        menuconfig BSP_USING_PWM2
            bool "Enable timer2 output pwm"
            default n
            if BSP_USING_PWM2
                config BSP_USING_PWM2_CH1
                    bool "Enable PWM2 channel1"
                    default n
            endif
        endif

endmenu

menu "Board extended module Drivers"

endmenu

endmenu
```

## bsp_for_art-badge/Kconfig
```kconfig
mainmenu "RT-Thread Configuration"

config BSP_DIR
    string
    default "."

config RTT_DIR
    string
    default "./rt-thread"

config PKGS_DIR
    string
    default "./package-indexs"


source "$RTT_DIR/Kconfig"
source "$PKGS_DIR/Kconfig"
source "board/Kconfig"
```

## bsp_for_art-badge/board/Kconfig
```kconfig
menu "Hardware Drivers Config"

config SOC_RTL_8762D
    bool
    select RT_USING_COMPONENTS_INIT
    select ARCH_ARM_CORTEX_M4
    default y

menu "Onboard Peripheral Drivers"

endmenu

menu "On-chip Peripheral Drivers"

    menuconfig BSP_USING_UART
        bool "Enable UART"
        default y
        select RT_USING_SERIAL
        if BSP_USING_UART
            config BSP_USING_UART0
                bool "Enable UART0"
                default y
        endif
    menuconfig BSP_USING_LCD
        bool "Enable LCD"
        default n
    menuconfig BSP_USING_PSRAM
        bool "Enable psram"
        default n
    menuconfig BSP_USING_BLE
        bool "Enable BLE"
        default n
        if BSP_USING_BLE
                config BSP_USING_REALTEK_BLE
                    bool "Enable REALTEK BLE"
                    default y
                config BSP_USING_BSAL
                    select PKG_USING_BSAL
                    bool "Enable BSAL BLE"
                    default n
        endif
    menuconfig BSP_USING_MSPI_FLASH
        bool "Enable mspi flash"
        default n
    menuconfig BSP_USING_FLASH
        bool "Enable Flash"
        default n
    menuconfig BSP_USING_PIN
        select RT_USING_PIN
        bool "Enable PIN device"
        default n
    menuconfig BSP_USING_I2C
        select RT_USING_I2C
        bool "Enable I2C Bus"
        default n
        if BSP_USING_I2C
                config BSP_USING_I2C1
                    bool "Enable I2C1"
                    default y
        endif
    
    menuconfig BSP_USING_TOUCHPAD
    bool "Enable touchpad"
    default n

    menuconfig BSP_USING_SIMULATOR_TOUCH
    bool "Enable simulator touch"
    default n
    
    menuconfig BSP_USING_BEEP
    bool "Enable beep"
    default y
    
    menuconfig BSP_USING_ADC
    bool "Enable ADC"
    default y
    
    menuconfig BSP_USING_DLPS
    bool "Enable dlps"
    default y
    
    menuconfig BSP_USING_PWM
        bool "Enable pwm"
        default n
        select RT_USING_PWM
        if BSP_USING_PWM
        menuconfig BSP_USING_PWM2
            bool "Enable timer2 output pwm"
            default n
            if BSP_USING_PWM2
                config BSP_USING_PWM2_CH1
                    bool "Enable PWM2 channel1"
                    default n
            endif
        endif
endmenu

menu "Board extended module Drivers"

endmenu

endmenu
```

## packages/persimwear-js-fwk/Kconfig
```kconfig
menu "PersimWear JS Framework"

source "$JSFW_DIR/base/cfgm/Kconfig"
source "$JSFW_DIR/base/dcm/Kconfig"
source "$JSFW_DIR/base/emq/Kconfig"
source "$JSFW_DIR/module/storage/Kconfig"
source "$JSFW_DIR/module/notification/Kconfig"
source "$JSFW_DIR/module/hardware/Kconfig"
source "$JSFW_DIR/module/sensor/Kconfig"
source "$JSFW_DIR/module/alarm/Kconfig"
endmenu
```

## packages/persimwear-js-fwk/base/cfgm/Kconfig
```kconfig
menuconfig JSFW_USING_CFGM
    bool "CFGM: Configuration management framework layer"
    select PKG_USING_CFGM
    default n
```

## packages/persimwear-js-fwk/base/dcm/Kconfig
```kconfig
menuconfig JSFW_USING_DCM
    bool "DCM: Data Cache Management framework layer"
    select PKG_USING_DCM
    default n
```

## packages/persimwear-js-fwk/base/emq/Kconfig
```kconfig
menuconfig JSFW_USING_EMQ
    bool "EMQ: Enhance Message Queue framework layer"
    select PKG_USING_EMQ
    default n
```

## packages/persimwear-js-fwk/module/alarm/Kconfig
```kconfig
menuconfig JSFW_USING_ALARM
    bool "Alarm: Implement abort alarm ops interface"
    select RT_USING_RTC
    select RT_USING_ALARM	
    default y
```

## packages/persimwear-js-fwk/module/hardware/Kconfig
```kconfig
menuconfig JSFW_USING_HARDWARE
    bool "HWS : Using Hardware Framework"
    select JSFW_USING_DCM
    select JSFW_USING_EMQ
    select RT_USING_TOUCH
    select RT_USING_DEVICE
    default n

    if JSFW_USING_HARDWARE

        config HWS_DEV_LCD_NAME
            string "the device name for lcd"
            default "lcd"

        config HWS_DEV_TP_NAME
            string "the device name for touchpanel"
            default "tp"

        menuconfig HWS_USING_VIBRATE
            bool "Enable vibrate"
            default y

            if HWS_USING_VIBRATE
                config HWS_VIBRATE_PWM_PIN
                    int "vibrate pin number"
                    default 35

                choice
                    prompt "active level"
                    default HWS_VIBRATE_ACTIVE_HIGH
                    help
                        The vibrate active level.
                    config HWS_VIBRATE_ACTIVE_HIGH
                        bool "Active High"
                    config HWS_VIBRATE_ACTIVE_LOW
                        bool "Active Low"
                endchoice
            endif

        menuconfig HWS_USING_KEY
            bool "Enable key"
            default y

            if HWS_USING_KEY
                config HWS_KEY_PIN
                    int "key pin number"
                    default 18

                config HWS_KEY_DEBOUNCE_TIME
                    int "key debounce press time"
                    default 20

                config HWS_KEY_LONG_PRESS_TIME
                    int "key long press time"
                    default 1500
            endif

        config JSFW_USING_HWS_CMD
            bool "HWS : Enable hws test cmd"
            default n
    endif
```

## packages/persimwear-js-fwk/module/notification/Kconfig
```kconfig
menuconfig JSFW_USING_NOTIFICATION
    bool "Notification: Implement message notification delivery"
    default y
	
if JSFW_USING_NOTIFICATION
    config JSFW_USING_NOTIFICATION_CMD
    bool "Enable notification test cmd"
    default n
endif
```

## packages/persimwear-js-fwk/module/sensor/Kconfig
```kconfig
menuconfig JSFW_USING_SENSOR
    bool "SENS : Using Sensor Device Framework"
    select JSFW_USING_DCM
    select JSFW_USING_EMQ
    select RT_USING_SENSOR
    select RT_USING_DEVICE
    default n

if JSFW_USING_SENSOR

	config SENS_ACCE_DEV_NAME
		string "SENS : the sensor device name for Accelerometer"
		default "acce_acc"

	config SENS_GYRO_DEV_NAME
		string "SENS : the sensor device name for Gyroscope"
		default "gyro_gyr"

	config SENS_MAG_DEV_NAME
		string "SENS : the sensor device name for Magnetometer"
		default "mag_magn"

	config SENS_TEMP_DEV_NAME
		string "SENS : the sensor device name for Temperature"
		default "temp_tem"

	config SENS_HUMI_DEV_NAME
		string "SENS : the sensor device name for Humidity"
		default "humi_hum"

	config SENS_BARO_DEV_NAME
		string "SENS : the sensor device name for Barometer"
		default "baro_bar"

	config SENS_LIGHT_DEV_NAME
		string "SENS : the sensor device name for Light"
		default "li_light"

	config SENS_PROX_DEV_NAME
		string "SENS : the sensor device name for Proximity"
		default "pr_proxi"

	config SENS_HR_DEV_NAME
		string "SENS : the sensor device name for HeartRate"
		default "hr_heart"

	config SENS_TVOC_DEV_NAME
		string "SENS : the sensor device name for TVOC"
		default "tvoc_tvo"

	config SENS_NOISE_DEV_NAME
		string "SENS : the sensor device name for NOISE"
		default "noi_nois"

	config SENS_STEP_DEV_NAME
		string "SENS : the sensor device name for StepCounter"
		default "step_ste"

	config SENS_FORCE_DEV_NAME
		string "SENS : the sensor device name for Force"
		default "forc_for"

	config SENS_SPO2_DEV_NAME
		string "SENS : the sensor device name for SPO2"
		default "spo2_sp2"

	config JSFW_USING_SENSOR_CMD
		bool "SENS : Enable sensor test cmd"
		default n

endif
```

## packages/persimwear-js-fwk/module/storage/Kconfig
```kconfig
menuconfig JSFW_USING_STORAGE
    bool "STORAGE: storage for JS framework layer"
    select PKG_USING_DCM
    select DCM_USING_STORAGE
    default n
```
